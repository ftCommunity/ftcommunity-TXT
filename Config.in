## configs/fischertechnik_TXT_defconfig
```kconfig
BR2_arm=y
BR2_cortex_a8=y
BR2_ARM_FPU_NEON=y
BR2_ARM_INSTRUCTIONS_THUMB2=y
BR2_JLEVEL=10
BR2_GLOBAL_PATCH_DIR="$(BR2_EXTERNAL_FTCOMMUNITY_TXT_PATH)/patches"
BR2_TOOLCHAIN_EXTERNAL=y
BR2_TOOLCHAIN_EXTERNAL_GDB_SERVER_COPY=y
BR2_TARGET_OPTIMIZATION="-pipe"
BR2_TARGET_GENERIC_HOSTNAME="FT-txt"
BR2_TARGET_GENERIC_ISSUE="Welcome to FT-txt"
BR2_ROOTFS_DEVICE_CREATION_DYNAMIC_EUDEV=y
BR2_ROOTFS_DEVICE_TABLE="system/device_table.txt $(BR2_EXTERNAL_FTCOMMUNITY_TXT_PATH)/board/fischertechnik/TXT/device_table.txt"
# BR2_TARGET_ENABLE_ROOT_LOGIN is not set
BR2_TARGET_GENERIC_GETTY_PORT="ttyO0"
BR2_TARGET_GENERIC_GETTY_BAUDRATE_115200=y
BR2_TARGET_GENERIC_GETTY_TERM="linux"
BR2_ENABLE_LOCALE_WHITELIST="C en_US de de_AT de_DE de_CH fr es nl pt"
BR2_GENERATE_LOCALE="en_US de_DE fr_FR nl_NL"
BR2_TARGET_TZ_INFO=y
BR2_TARGET_LOCALTIME="Europe/Berlin"
BR2_ROOTFS_USERS_TABLES="$(BR2_EXTERNAL_FTCOMMUNITY_TXT_PATH)/board/fischertechnik/TXT/user.tab"
BR2_ROOTFS_OVERLAY="$(BR2_EXTERNAL_FTCOMMUNITY_TXT_PATH)/board/fischertechnik/TXT/rootfs $(FTC_TXT_CUSTOM)"
BR2_ROOTFS_POST_BUILD_SCRIPT="$(BR2_EXTERNAL_FTCOMMUNITY_TXT_PATH)/board/fischertechnik/TXT/post-build.sh"
BR2_ROOTFS_POST_IMAGE_SCRIPT="$(BR2_EXTERNAL_FTCOMMUNITY_TXT_PATH)/board/fischertechnik/TXT/post-image.sh"
BR2_LINUX_KERNEL=y
BR2_LINUX_KERNEL_CUSTOM_GIT=y
BR2_LINUX_KERNEL_CUSTOM_REPO_URL="https://git.kernel.org/pub/scm/linux/kernel/git/stable/linux.git"
BR2_LINUX_KERNEL_CUSTOM_REPO_VERSION="v4.14.97"
BR2_LINUX_KERNEL_PATCH="$(BR2_EXTERNAL_FTCOMMUNITY_TXT_PATH)/board/fischertechnik/TXT/patches/linux"
BR2_LINUX_KERNEL_USE_CUSTOM_CONFIG=y
BR2_LINUX_KERNEL_CUSTOM_CONFIG_FILE="$(BR2_EXTERNAL_FTCOMMUNITY_TXT_PATH)/board/fischertechnik/TXT/tisdk_am335x-fischertechnik_txt_defconfig"
BR2_LINUX_KERNEL_UIMAGE=y
BR2_LINUX_KERNEL_UIMAGE_LOADADDR="0x80008000"
BR2_LINUX_KERNEL_DTS_SUPPORT=y
BR2_LINUX_KERNEL_CUSTOM_DTS_PATH="$(BR2_EXTERNAL_FTCOMMUNITY_TXT_PATH)/board/fischertechnik/TXT/am335x-kno_txt.dts"
BR2_PACKAGE_BUSYBOX_SHOW_OTHERS=y
BR2_PACKAGE_ALSA_UTILS=y
BR2_PACKAGE_ALSA_UTILS_APLAY=y
BR2_PACKAGE_MPG123=y
BR2_PACKAGE_SOX=y
BR2_PACKAGE_BZIP2=y
BR2_PACKAGE_STRACE=y
BR2_PACKAGE_DOSFSTOOLS=y
BR2_PACKAGE_DOSFSTOOLS_MKFS_FAT=y
BR2_PACKAGE_E2FSPROGS=y
BR2_PACKAGE_FLASHBENCH=y
BR2_PACKAGE_MMC_UTILS=y
BR2_PACKAGE_MTD=y
BR2_PACKAGE_MTD_MKFSUBIFS=y
BR2_PACKAGE_UNIONFS=y
BR2_PACKAGE_FB_TEST_APP=y
BR2_PACKAGE_FBGRAB=y
BR2_PACKAGE_FBSET=y
BR2_PACKAGE_FBTERM=y
BR2_PACKAGE_FBV=y
BR2_PACKAGE_PSPLASH=y
BR2_PACKAGE_SDL_GFX=y
BR2_PACKAGE_SDL_IMAGE_GIF=y
BR2_PACKAGE_SDL_IMAGE_PCX=y
BR2_PACKAGE_SDL_IMAGE_TARGA=y
BR2_PACKAGE_SDL_IMAGE_TIFF=y
BR2_PACKAGE_SDL_NET=y
BR2_PACKAGE_QT5=y
BR2_PACKAGE_QT5BASE_FONTCONFIG=y
BR2_PACKAGE_QT5BASE_JPEG=y
BR2_PACKAGE_QT5BASE_PNG=y
BR2_PACKAGE_QT5BASE_TSLIB=y
BR2_PACKAGE_QT5MQTT=y
BR2_PACKAGE_AM33X_CM3=y
BR2_PACKAGE_LINUX_FIRMWARE=y
BR2_PACKAGE_LINUX_FIRMWARE_RTL_81XX=y
BR2_PACKAGE_LINUX_FIRMWARE_TI_WL18XX=y
BR2_PACKAGE_AVRDUDE=y
BR2_PACKAGE_DBUS_CPP=y
BR2_PACKAGE_DBUS_GLIB=y
BR2_PACKAGE_DBUS_TRIGGERD=y
BR2_PACKAGE_EVEMU=y
BR2_PACKAGE_EVTEST=y
BR2_PACKAGE_HWDATA=y
BR2_PACKAGE_I2C_TOOLS=y
BR2_PACKAGE_KBD=y
BR2_PACKAGE_RNG_TOOLS=y
# BR2_PACKAGE_RNG_TOOLS_JITTERENTROPY_LIBRARY is not set
BR2_PACKAGE_TI_UIM=y
BR2_PACKAGE_TI_UTILS=y
BR2_PACKAGE_TRIGGERHAPPY=y
BR2_PACKAGE_USB_MODESWITCH_DATA=y
BR2_PACKAGE_USBMOUNT=y
BR2_PACKAGE_USBUTILS=y
BR2_PACKAGE_PYTHON3=y
BR2_PACKAGE_PYTHON3_SQLITE=y
BR2_PACKAGE_PYTHON_BEAUTIFULSOUP4=y
BR2_PACKAGE_PYTHON_LXML=y
BR2_PACKAGE_PYTHON_NETIFACES=y
BR2_PACKAGE_PYTHON_PAHO_MQTT=y
BR2_PACKAGE_PYTHON_PYGAME=y
BR2_PACKAGE_PYTHON_PYGAME_IMAGE=y
BR2_PACKAGE_PYTHON_PYGAME_FONT=y
BR2_PACKAGE_PYTHON_PYQT5=y
BR2_PACKAGE_PYTHON_SETUPTOOLS=y
BR2_PACKAGE_PYTHON_SMBUS_CFFI=y
BR2_PACKAGE_PYTHON_SPIDEV=y
BR2_PACKAGE_PYTHON_WEBSOCKET_CLIENT=y
BR2_PACKAGE_PYTHON_WEBSOCKETS=y
BR2_PACKAGE_CA_CERTIFICATES=y
BR2_PACKAGE_GNUTLS=y
BR2_PACKAGE_GNUTLS_TOOLS=y
BR2_PACKAGE_LIBSYSFS=y
BR2_PACKAGE_ATK=y
BR2_PACKAGE_CAIRO_PS=y
BR2_PACKAGE_CAIRO_XML=y
BR2_PACKAGE_OPENCV3=y
BR2_PACKAGE_OPENCV3_WITH_QT5=y
BR2_PACKAGE_OPENCV3_LIB_PYTHON=y
BR2_PACKAGE_OPENCV3_LIB_SHAPE=y
BR2_PACKAGE_OPENCV3_LIB_STITCHING=y
BR2_PACKAGE_OPENCV3_LIB_SUPERRES=y
BR2_PACKAGE_OPENCV3_LIB_TS=y
BR2_PACKAGE_OPENCV3_LIB_VIDEOSTAB=y
BR2_PACKAGE_OPENCV3_BUILD_TESTS=y
BR2_PACKAGE_OPENCV3_BUILD_PERF_TESTS=y
BR2_PACKAGE_OPENCV3_WITH_JPEG=y
BR2_PACKAGE_OPENCV3_WITH_PNG=y
BR2_PACKAGE_OPENCV3_WITH_V4L=y
BR2_PACKAGE_PANGO=y
BR2_PACKAGE_ZBAR=y
BR2_PACKAGE_JITTERENTROPY_LIBRARY=y
BR2_PACKAGE_LIBHID=y
BR2_PACKAGE_LIBV4L_UTILS=y
BR2_PACKAGE_LIBFCGI=y
BR2_PACKAGE_LIBNETFILTER_CONNTRACK=y
BR2_PACKAGE_LIBNETFILTER_CTHELPER=y
BR2_PACKAGE_LIBNETFILTER_CTTIMEOUT=y
BR2_PACKAGE_LIBNETFILTER_QUEUE=y
BR2_PACKAGE_LIBNFTNL=y
BR2_PACKAGE_LIBVNCSERVER=y
BR2_PACKAGE_LIBCAP_NG=y
BR2_PACKAGE_LIBPTHREAD_STUBS=y
BR2_PACKAGE_LINUX_PAM=y
BR2_PACKAGE_NCURSES_TARGET_PROGS=y
BR2_PACKAGE_PCRE_16=y
BR2_PACKAGE_AESPIPE=y
BR2_PACKAGE_ARPTABLES=y
BR2_PACKAGE_BLUEZ5_UTILS_CLIENT=y
BR2_PACKAGE_BLUEZ5_UTILS_TOOLS=y
BR2_PACKAGE_BLUEZ5_UTILS_DEPRECATED=y
BR2_PACKAGE_BRIDGE_UTILS=y
BR2_PACKAGE_CRDA=y
BR2_PACKAGE_DHCP=y
BR2_PACKAGE_DHCP_SERVER=y
BR2_PACKAGE_DHCP_SERVER_DELAYED_ACK=y
BR2_PACKAGE_DHCP_RELAY=y
BR2_PACKAGE_GESFTPSERVER=y
BR2_PACKAGE_HOSTAPD=y
BR2_PACKAGE_HOSTAPD_EAP=y
BR2_PACKAGE_HOSTAPD_WPS=y
BR2_PACKAGE_IFTOP=y
BR2_PACKAGE_IPTABLES=y
BR2_PACKAGE_IW=y
BR2_PACKAGE_LIGHTTPD=y
BR2_PACKAGE_LIGHTTPD_PCRE=y
BR2_PACKAGE_NET_TOOLS=y
BR2_PACKAGE_NETCAT=y
BR2_PACKAGE_NTP=y
BR2_PACKAGE_OPENOBEX=y
BR2_PACKAGE_OPENSSH=y
BR2_PACKAGE_OPENVPN=y
BR2_PACKAGE_RSYNC=y
BR2_PACKAGE_SPAWN_FCGI=y
BR2_PACKAGE_WGET=y
BR2_PACKAGE_WIRELESS_TOOLS=y
BR2_PACKAGE_WIRELESS_TOOLS_LIB=y
BR2_PACKAGE_WPA_SUPPLICANT=y
BR2_PACKAGE_WPA_SUPPLICANT_AP_SUPPORT=y
BR2_PACKAGE_WPA_SUPPLICANT_HOTSPOT=y
BR2_PACKAGE_WPA_SUPPLICANT_DEBUG_SYSLOG=y
BR2_PACKAGE_WPA_SUPPLICANT_WPS=y
BR2_PACKAGE_WPA_SUPPLICANT_CLI=y
BR2_PACKAGE_WPA_SUPPLICANT_PASSPHRASE=y
BR2_PACKAGE_WPA_SUPPLICANT_DBUS=y
BR2_PACKAGE_WPA_SUPPLICANT_DBUS_INTROSPECTION=y
BR2_PACKAGE_DASH=y
BR2_PACKAGE_GNUPG=y
BR2_PACKAGE_GNUPG_RSA=y
BR2_PACKAGE_SCREEN=y
BR2_PACKAGE_SUDO=y
BR2_PACKAGE_HTOP=y
BR2_PACKAGE_PROCPS_NG=y
BR2_PACKAGE_ED=y
BR2_PACKAGE_JOE=y
BR2_PACKAGE_LESS=y
BR2_PACKAGE_NANO=y
BR2_TARGET_ROOTFS_INITRAMFS=y
BR2_TARGET_ROOTFS_INITRAMFS_CUSTOM=y
BR2_TARGET_ROOTFS_INITRAMFS_CUSTOM_CONTENTS="$(BR2_EXTERNAL_FTCOMMUNITY_TXT_PATH)/board/fischertechnik/TXT/initramfs.conf"
BR2_TARGET_ROOTFS_SQUASHFS=y
BR2_TARGET_ROOTFS_SQUASHFS4_LZ4=y
# BR2_TARGET_ROOTFS_TAR is not set
BR2_PACKAGE_FT_BT_REMOTE_SERVER=y
BR2_PACKAGE_LIBROBOINT=y
BR2_PACKAGE_PYTHON_FTROBOPY=y
BR2_PACKAGE_PYTHON_FTTXPY=y
BR2_PACKAGE_PYTHON_LIBROBOINT=y
BR2_PACKAGE_PYTHON_LUMALED_MATRIX=y
BR2_PACKAGE_PYTHON_LUMAOLED=y
BR2_PACKAGE_PYTHON_ROBOLT=y
BR2_PACKAGE_PYTHON_SEMANTIC_VERSION1=y
BR2_PACKAGE_PYTHON_ZBARLIGHT=y
```

## configs/knobloch_TXT_defconfig
```kconfig
# architecture
BR2_arm=y
BR2_cortex_a8=y
BR2_ARM_FPU_NEON=y
BR2_ARM_INSTRUCTIONS_THUMB2=y

#toolchain
BR2_TOOLCHAIN_EXTERNAL=y
BR2_TOOLCHAIN_EXTERNAL_GDB_SERVER_COPY=y

# system
BR2_TARGET_GENERIC_HOSTNAME="FT-txt"
BR2_TARGET_GENERIC_ISSUE="Welcome to FT-txt"
BR2_TARGET_GENERIC_ROOT_PASSWD="root"
BR2_TARGET_GENERIC_GETTY_PORT="ttyO0"
BR2_TARGET_GENERIC_GETTY_BAUDRATE_115200=y
BR2_TARGET_GENERIC_GETTY_TERM="linux"
BR2_TARGET_OPTIMIZATION="-pipe"
BR2_ENABLE_LOCALE_PURGE=y
BR2_ENABLE_LOCALE_WHITELIST="C en_US de de_AT de_DE de_CH fr es nl pt"
BR2_TARGET_TZ_INFO=y
BR2_TARGET_LOCALTIME="Europe/Berlin"

# filesystem
BR2_PACKAGE_AM33X_CM3=y
BR2_ROOTFS_DEVICE_CREATION_DYNAMIC_EUDEV=y
BR2_ROOTFS_USERS_TABLES="board/knobloch/TXT/user.tab"
#BR2_ROOTFS_POST_BUILD_SCRIPT="board/knobloch/TXT/post-build.sh"

# kernel
BR2_LINUX_KERNEL=y
BR2_LINUX_KERNEL_CUSTOM_GIT=y
BR2_LINUX_KERNEL_CUSTOM_REPO_URL="git://git.ti.com/ti-linux-kernel/ti-linux-kernel.git"
BR2_LINUX_KERNEL_CUSTOM_REPO_VERSION=ti-linux-4.1.y
BR2_LINUX_KERNEL_USE_CUSTOM_CONFIG=y
BR2_LINUX_KERNEL_CUSTOM_CONFIG_FILE="board/knobloch/TXT/tisdk_am335x-knobloch_txt_defconfig"
BR2_LINUX_KERNEL_UIMAGE_LOADADDR="0x80008000"
BR2_LINUX_KERNEL_DTS_SUPPORT=y
BR2_LINUX_KERNEL_USE_CUSTOM_DTS=y
BR2_LINUX_KERNEL_CUSTOM_DTS_PATH="board/knobloch/TXT/am335x-kno_txt.dts"

# packages
BR2_PACKAGE_BZIP2=y
BR2_PACKAGE_STRACE=y
BR2_PACKAGE_FLASHBENCH=y
BR2_PACKAGE_MMC_UTILS=y
BR2_PACKAGE_MTD=y
BR2_PACKAGE_MTD_MKFSUBIFS=y
BR2_PACKAGE_DIRECTFB=y
BR2_PACKAGE_DIRECTFB_MULTI=y
BR2_PACKAGE_FBGRAB=y
BR2_PACKAGE_FBSET=y
BR2_PACKAGE_FB_TEST_APP=y
BR2_PACKAGE_FBTERM=y
BR2_PACKAGE_FBV=y
BR2_PACKAGE_PSPLASH=y
BR2_PACKAGE_SDL=y
BR2_PACKAGE_SDL_DIRECTFB=y
BR2_PACKAGE_SDL_GFX=y
BR2_PACKAGE_SDL_IMAGE=y
BR2_PACKAGE_SDL_IMAGE_GIF=y
BR2_PACKAGE_SDL_IMAGE_JPEG=y
BR2_PACKAGE_SDL_IMAGE_PCX=y
BR2_PACKAGE_SDL_IMAGE_PNG=y
BR2_PACKAGE_SDL_IMAGE_TARGA=y
BR2_PACKAGE_SDL_IMAGE_TIFF=y
BR2_PACKAGE_SDL_NET=y
BR2_PACKAGE_SDL_TTF=y
BR2_PACKAGE_LINUX_FIRMWARE=y
BR2_PACKAGE_LINUX_FIRMWARE_RTL_81XX=y
BR2_PACKAGE_LINUX_FIRMWARE_TI_WL127X=y
BR2_PACKAGE_LINUX_FIRMWARE_TI_WL128X=y
BR2_PACKAGE_DBUS_CPP=y
BR2_PACKAGE_DBUS_GLIB=y
BR2_PACKAGE_DBUS_TRIGGERD=y
BR2_PACKAGE_DEVMEM2=y
BR2_PACKAGE_EEPROG=y
BR2_PACKAGE_EVEMU=y
BR2_PACKAGE_EVTEST=y
BR2_PACKAGE_HWDATA=y
BR2_PACKAGE_I2C_TOOLS=y
BR2_PACKAGE_KBD=y
BR2_PACKAGE_RNG_TOOLS=y
BR2_PACKAGE_TI_UIM=y
BR2_PACKAGE_TI_UTILS=y
BR2_PACKAGE_USB_MODESWITCH_DATA=y
BR2_PACKAGE_USBMOUNT=y
BR2_PACKAGE_USBUTILS=y
BR2_PACKAGE_GNUTLS=y
BR2_PACKAGE_GNUTLS_TOOLS=y
BR2_PACKAGE_OPENSSL_BIN=y
BR2_PACKAGE_OPENSSL_ENGINES=y
BR2_PACKAGE_SQLITE=y
BR2_PACKAGE_SQLITE_READLINE=y
BR2_PACKAGE_LIBFUSE=y
BR2_PACKAGE_LIBSYSFS=y
BR2_PACKAGE_ATK=y
BR2_PACKAGE_CAIRO_PS=y
BR2_PACKAGE_CAIRO_XML=y
BR2_PACKAGE_GDK_PIXBUF=y
BR2_PACKAGE_PANGO=y
BR2_PACKAGE_LIBHID=y
BR2_PACKAGE_LIBV4L=y
BR2_PACKAGE_LIBXSLT=y
BR2_PACKAGE_LIBFCGI=y
BR2_PACKAGE_LIBNETFILTER_CONNTRACK=y
BR2_PACKAGE_LIBNETFILTER_CTHELPER=y
BR2_PACKAGE_LIBNETFILTER_CTTIMEOUT=y
BR2_PACKAGE_LIBNFTNL=y
BR2_PACKAGE_LIBNFTNL_XML=y
BR2_PACKAGE_LIBVNCSERVER=y
BR2_PACKAGE_LIBCAP_NG=y
BR2_PACKAGE_LIBPTHREAD_STUBS=y
BR2_PACKAGE_NCURSES_TARGET_PANEL=y
BR2_PACKAGE_NCURSES_TARGET_FORM=y
BR2_PACKAGE_NCURSES_TARGET_MENU=y
BR2_PACKAGE_NCURSES_TARGET_PROGS=y
BR2_PACKAGE_PCRE_16=y
BR2_PACKAGE_AESPIPE=y
BR2_PACKAGE_ARPTABLES=y
BR2_PACKAGE_BLUEZ_UTILS_COMPAT=y
BR2_PACKAGE_BLUEZ_UTILS_AUDIO=y
BR2_PACKAGE_BLUEZ_UTILS_USB=y
BR2_PACKAGE_BLUEZ_UTILS_GATT=y
BR2_PACKAGE_BRIDGE_UTILS=y
BR2_PACKAGE_CRDA=y
BR2_PACKAGE_DHCP=y
BR2_PACKAGE_DHCP_SERVER=y
BR2_PACKAGE_DHCP_SERVER_DELAYED_ACK=y
BR2_PACKAGE_DHCP_RELAY=y
BR2_PACKAGE_DHCPCD=y
BR2_PACKAGE_GESFTPSERVER=y
BR2_PACKAGE_HOSTAPD=y
BR2_PACKAGE_HOSTAPD_EAP=y
BR2_PACKAGE_HOSTAPD_WPS=y
BR2_PACKAGE_IFTOP=y
BR2_PACKAGE_IPTABLES=y
BR2_PACKAGE_IW=y
BR2_PACKAGE_NET_TOOLS=y
BR2_PACKAGE_OPENOBEX=y
BR2_PACKAGE_OPENOBEX_BLUEZ=y
BR2_PACKAGE_OPENOBEX_LIBUSB=y
BR2_PACKAGE_OPENSSH=y
BR2_PACKAGE_OPENVPN=y
BR2_PACKAGE_SPAWN_FCGI=y
BR2_PACKAGE_WGET=y
BR2_PACKAGE_WIRELESS_TOOLS=y
BR2_PACKAGE_WIRELESS_TOOLS_LIB=y
BR2_PACKAGE_WPA_SUPPLICANT=y
BR2_PACKAGE_WPA_SUPPLICANT_AP_SUPPORT=y
BR2_PACKAGE_WPA_SUPPLICANT_EAP=y
BR2_PACKAGE_WPA_SUPPLICANT_HOTSPOT=y
BR2_PACKAGE_WPA_SUPPLICANT_DEBUG_SYSLOG=y
BR2_PACKAGE_WPA_SUPPLICANT_WPS=y
BR2_PACKAGE_WPA_SUPPLICANT_CLI=y
BR2_PACKAGE_WPA_SUPPLICANT_PASSPHRASE=y
BR2_PACKAGE_WPA_SUPPLICANT_DBUS_OLD=y
BR2_PACKAGE_WPA_SUPPLICANT_DBUS_NEW=y
BR2_PACKAGE_WPA_SUPPLICANT_DBUS_INTROSPECTION=y
BR2_PACKAGE_DASH=y
BR2_PACKAGE_GNUPG=y
BR2_PACKAGE_GNUPG_RSA=y
BR2_PACKAGE_SCREEN=y
BR2_PACKAGE_SUDO=y
BR2_PACKAGE_HTOP=y
BR2_PACKAGE_ED=y
BR2_PACKAGE_JOE=y
BR2_PACKAGE_LESS=y
BR2_PACKAGE_NANO=y
BR2_PACKAGE_LIBEINA=y
BR2_PACKAGE_LIBECORE=y
BR2_PACKAGE_LIBEDBUS=y
BR2_PACKAGE_DIVINE=y
BR2_PACKAGE_LIBV4L_IR_KEYTABLE=y
BR2_PACKAGE_LIBV4L_V4L2_COMPLIANCE=y
BR2_PACKAGE_LIBV4L_V4L2_CTL=y
```

## fs/initramfs/Config.in
```kconfig
config BR2_TARGET_ROOTFS_INITRAMFS
	bool "initial RAM filesystem linked into linux kernel"
	depends on BR2_LINUX_KERNEL
	help
	  Integrate an initramfs inside the kernel image.
	  This integration will take place automatically.

	  The initramfs contents can either be the full root filesystem
	  generated by buildroot, or an image built from a custom list
	  of files specified via the BR2_TARGET_ROOTFS_INITRAMFS_CUSTOM_CONTENTS
	  config option.

choice
	prompt "initial RAM filesystem contents"
	depends on BR2_TARGET_ROOTFS_INITRAMFS

config BR2_TARGET_ROOTFS_INITRAMFS_ROOTFS
	bool "rootfs.cpio"
	depends on BR2_TARGET_ROOTFS_INITRAMFS
	select BR2_TARGET_ROOTFS_CPIO
	help
	  Integrate the root filesystem generated by Buildroot as an
	  initramfs inside the kernel image. This integration will
	  take place automatically.

	  A rootfs.cpio file will be generated in the images/ directory.
	  This is the archive that will be included in the kernel image.
	  The default rootfs compression set in the kernel configuration
	  is used, regardless of how buildroot's cpio archive is
	  configured.

	  Note that enabling this option together with another filesystem
	  formats doesn't make sense: you would end up having two
	  identical root filesystems, one embedded inside the kernel
	  image, and one separately.
config BR2_TARGET_ROOTFS_INITRAMFS_CUSTOM
	bool "custom initramfs contents"
	depends on BR2_TARGET_ROOTFS_INITRAMFS
	help
	  Use the contents of BR2_TARGET_ROOTFS_INITRAMFS_CUSTOM_CONTENTS
	  as the linux kernel configuration variable CONFIG_INITRAMFS_SOURCE

endchoice

config BR2_TARGET_ROOTFS_INITRAMFS_CUSTOM_CONTENTS
	string "custom initramfs contents"
	depends on BR2_TARGET_ROOTFS_INITRAMFS_CUSTOM
	help
	  Custom value to use as CONFIG_INITRAMFS_SOURCE linux kernel configuration
	  variable. See Documentation/filesystems/ramfs-rootfs-initramfs.txt in the
	  linux kernel sources for details.

comment "initramfs needs a Linux kernel to be built"
	depends on !BR2_LINUX_KERNEL
```

## fs/txtzip/Config.in
```kconfig
config BR2_TARGET_ROOTFS_TXTZIP
	bool "TXT sd card zip"

if BR2_TARGET_ROOTFS_TXTZIP
	config BR2_TARGET_ROOTFS_TXTZIP_CUSTOM_NAME
		bool "Custom file name"

	if BR2_TARGET_ROOTFS_TXTZIP_CUSTOM_NAME
		choice
			prompt "Name source"
			default BR2_TARGET_ROOTFS_TXTZIP_CUSTOM_NAME_SOURCE_STRING

		config BR2_TARGET_ROOTFS_TXTZIP_CUSTOM_NAME_SOURCE_STRING
			bool "String"

		config BR2_TARGET_ROOTFS_TXTZIP_CUSTOM_NAME_SOURCE_FILE
			bool "File"

		endchoice

		if BR2_TARGET_ROOTFS_TXTZIP_CUSTOM_NAME_SOURCE_FILE
			config BR2_TARGET_ROOTFS_TXTZIP_CUSTOM_NAME_SOURCE_FILE_NAME
				string "Source File"

			config BR2_TARGET_ROOTFS_TXTZIP_CUSTOM_NAME_PREFIX
				string "Prefix"

			config BR2_TARGET_ROOTFS_TXTZIP_CUSTOM_NAME_SUFFIX
				string "Suffix"
		endif

		if BR2_TARGET_ROOTFS_TXTZIP_CUSTOM_NAME_SOURCE_STRING
			config BR2_TARGET_ROOTFS_TXTZIP_CUSTOM_NAME_NAME
				string "File name"
				default "txt"
		endif

		config BR2_TARGET_ROOTFS_TXTZIP_CUSTOM_NAME_EXTENSION
			string "Extension"
			default "zip"
	endif

	config BR2_TARGET_ROOTFS_TXTZIP_CONFIG
		string "File list config file"
		help
			Path to output configuration file
			File format:
			Use one line per file/directory

			Lines must use one of the following formats:
			<source path>
			<source path>-><target path>

			Target must not be an absolute path
			If target is unspecified the file will just be copied to the root of the output structure
			If target is a file name the file will be copied using this name to the root of the output structure
			If target is a path the file will be copied to the specified path in the output structure. The directory will be created automatically

	config BR2_TARGET_ROOTFS_TXTZIP_DEPENDS
		string "Depending packages"
		default ""
		help
			List of packages that need to be built before
			For example: rootfs-initramfs rootfs-squashfs
endif
```
