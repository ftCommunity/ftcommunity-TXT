## package/ft_bt_remote_server/Config.in
```kconfig
config BR2_PACKAGE_FT_BT_REMOTE_SERVER
	bool "ft_bt_remote_server"
    select BR2_PACKAGE_BLUEZ_UTILS
	help
	  The ft_bt_remote_server allows to use the fischertechnik
	  remote control sender unit from the BT Control Set as a
	  joystick under Linux.

	  https://github.com/ftCommunity/ft_bt_remote_server
```

## package/ft_txt_snd_cat/Config.in
```kconfig
config BR2_PACKAGE_FT_TXT_SND_CAT
    bool "ft_txt_snd_cat"
    help
        Install ft_txt_snd_cat
```

## package/libroboint/Config.in
```kconfig
config BR2_PACKAGE_LIBROBOINT
  bool "libroboint"
  select BR2_PACKAGE_LIBUSB
  select BR2_PACKAGE_LIBUSB_COMPAT
  select BR2_PACKAGE_BINUTILS
  select BR2_PACKAGE_BINUTILS_TARGET 
  help
    Install libroboint

config BR2_PACKAGE_LIBROBOINT_PYTHON
  bool "libroboint python bindings"
  depends on BR2_PACKAGE_LIBROBOINT
  depends on BR2_PACKAGE_PYTHON3
  help
    Install libroboint python bindings
```

## package/netreq/Config.in
```kconfig
config BR2_PACKAGE_NETREQ
        bool "netreq"
        select BR2_PACKAGE_LIBNETFILTER_QUEUE
        help
          netreq is a program to intercept incoming tcp connection
	  requests. It was developed for the fischertechnik TXT
	  community firmware.

config BR2_PACKAGE_NETREQ_INITD_ENABLE
  depends on BR2_PACKAGE_NETREQ
  bool "add netreq to init.d"
  default y

if BR2_PACKAGE_NETREQ_INITD_ENABLE
  config BR2_PACKAGE_NETREQ_INITD_NAME
    string "netreq init.d filename"
    default S41netreq
endif
```

## package/posixovlfs/Config.in
```kconfig
config BR2_PACKAGE_POSIXOVLFS
	bool "POSIX overlay fs (FUSE)"
	select BR2_PACKAGE_LIBFUSE
	select BR2_PACKAGE_ATTR
	depends on BR2_TOOLCHAIN_HAS_THREADS # libfuse
	depends on BR2_USE_MMU # libfuse
	depends on !BR2_STATIC_LIBS # libfuse
	help
	  POSIX overlay filesystem

	  https://sourceforge.net/projects/posixovl

comment "POSIX overlay fs needs a toolchain w/ threads, dynamic library"
	depends on BR2_USE_MMU
	depends on !BR2_TOOLCHAIN_HAS_THREADS || BR2_STATIC_LIBS
```

## package/python-ftduino-direct/Config.in
```kconfig
config BR2_PACKAGE_PYTHON_FTDUINO_DIRECT
	bool "python-ftduino-direct"
	select BR2_PACKAGE_PYTHON_SERIAL
	help
	  Python interface for the Till Harbaum's ftduino

	  https://github.com/PeterDHabermehl/ftduino_direct
```

## package/python-ftframework/Config.in
```kconfig
config BR2_PACKAGE_PYTHON_FTFRAMEWORK
	bool "python-ftframework"
	depends on BR2_PACKAGE_PYTHON3
	select BR2_PACKAGE_PYTHON_TWISTED
	help
		This framework is designed for controlling big fischertehnik models with multiple computers.
		https://github.com/ski7777/ftframework
```

## package/python-ftifpy/Config.in
```kconfig
config BR2_PACKAGE_PYTHON_FTIFPY
  bool "libroboint"
  select BR2_PACKAGE_PYTHON_LIBROBOINT
  help
    Install Python-ftifpy
```

## package/python-ftrobopy/Config.in
```kconfig
config BR2_PACKAGE_PYTHON_FTROBOPY
	bool "python-ftrobopy"
	select BR2_PACKAGE_PYTHON_SERIAL
	help
	  Python interface for the Fischertechnik ROBOTICS TXT Controller

	  https://github.com/ftrobopy/ftrobopy
```

## package/python-fttxpy/Config.in
```kconfig
config BR2_PACKAGE_PYTHON_FTTXPY
  bool "libroboint"
  select BR2_PACKAGE_PYTHON_PYUDEV
  select BR2_PACKAGE_PYTHON_SERIAL
  help
    Install Python-fttxpy
```

## package/python-ipykernel/Config.in
```kconfig
config BR2_PACKAGE_PYTHON_IPYKERNEL
	bool "python-ipykernel"
	select BR2_PACKAGE_PYTHON_IPYTHON # runtime
	select BR2_PACKAGE_PYTHON_TRAITLETS # runtime
	select BR2_PACKAGE_PYTHON_JUPYTER_CLIENT # runtime
	select BR2_PACKAGE_PYTHON_TORNADO # runtime
	help
	  IPython Kernel for Jupyter.

	  http://ipython.org
```

## package/python-ipython/Config.in
```kconfig
config BR2_PACKAGE_PYTHON_IPYTHON
	bool "python-ipython"
	select BR2_PACKAGE_PYTHON_SETUPTOOLS # runtime
	select BR2_PACKAGE_PYTHON_DECORATOR # runtime
	select BR2_PACKAGE_PYTHON_PICKLESHARE # runtime
	select BR2_PACKAGE_PYTHON_SIMPLEGENERIC # runtime
	select BR2_PACKAGE_PYTHON_TRAITLETS # runtime
	select BR2_PACKAGE_PYTHON_PROMPT_TOOLKIT # runtime
	select BR2_PACKAGE_PYTHON_PYGMENTS # runtime
	select BR2_PACKAGE_PYTHON_PEXPECT # runtime
	help
	  IPython: Productive Interactive Computing.

	  http://ipython.org
```

## package/python-ipython_genutils/Config.in
```kconfig
config BR2_PACKAGE_PYTHON_IPYTHON_GENUTILS
	bool "python-ipython_genutils"
	help
	  Vestigial utilities from IPython.

	  http://ipython.org
```

## package/python-jupyter_client/Config.in
```kconfig
config BR2_PACKAGE_PYTHON_JUPYTER_CLIENT
	bool "python-jupyter_client"
	select BR2_PACKAGE_PYTHON_TRAITLETS # runtime
	select BR2_PACKAGE_PYTHON_JUPYTER_CORE # runtime
	select BR2_PACKAGE_PYTHON_PYZMQ # runtime
	help
	  Jupyter protocol implementation and client libraries.

	  http://jupyter.org
```

## package/python-jupyter_core/Config.in
```kconfig
config BR2_PACKAGE_PYTHON_JUPYTER_CORE
	bool "python-jupyter_core"
	select BR2_PACKAGE_PYTHON_TRAITLETS # runtime
	help
	  Jupyter core package. A base package on which Jupyter projects
	  rely.

	  http://jupyter.org
```

## package/python-libroboint/Config.in
```kconfig
config BR2_PACKAGE_PYTHON_LIBROBOINT
  bool "pylibroboint"
  depends on BR2_PACKAGE_LIBROBOINT
  help
    Python module for libroboint
```

## package/python-lidar/Config.in
```kconfig
config BR2_PACKAGE_PYTHON_LIDAR
	bool "python-lidar"
	help
	  VL53L0X Python interface
```

## package/python-lumacore/Config.in
```kconfig
config BR2_PACKAGE_PYTHON_LUMACORE
	bool "python-lumacore"
	select BR2_PACKAGE_PYTHON_PILLOW # runtime
	select BR2_PACKAGE_PYTHON_SMBUS2 # runtime
	help
	  A component library to support SBC display drivers.

	  https://github.com/rm-hull/luma.core
```

## package/python-lumaled_matrix/Config.in
```kconfig
config BR2_PACKAGE_PYTHON_LUMALED_MATRIX
	bool "python-lumaled_matrix"
	select BR2_PACKAGE_PYTHON_LUMACORE # runtime
	help
	  A library to drive a MAX7219 LED serializer (using SPI) and
	  WS2812 NeoPixels (using DMA).

	  https://github.com/rm-hull/luma.led_matrix
```
