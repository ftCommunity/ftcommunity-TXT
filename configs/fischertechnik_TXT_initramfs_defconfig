## configs/fischertechnik_TXT_initramfs_defconfig
```kconfig
BR2_arm=y
BR2_cortex_a8=y
BR2_ARM_FPU_NEON=y
BR2_ARM_INSTRUCTIONS_THUMB2=y
BR2_TOOLCHAIN_EXTERNAL=y
BR2_TARGET_OPTIMIZATION="-pipe"
BR2_CCACHE=y
BR2_GLOBAL_PATCH_DIR="$(BR2_EXTERNAL_FTCOMMUNITY_TXT_PATH)/patches"
BR2_TARGET_GENERIC_HOSTNAME="FT-txt"
BR2_TARGET_GENERIC_ISSUE="Welcome to FT-txt"
BR2_INIT_NONE=y
BR2_ROOTFS_DEVICE_CREATION_DYNAMIC_DEVTMPFS=y
BR2_ROOTFS_DEVICE_TABLE="system/device_table.txt $(BR2_EXTERNAL_FTCOMMUNITY_TXT_PATH)/board/fischertechnik/TXT/device_table_initramfs.txt"
BR2_ROOTFS_MERGED_USR=y
# BR2_TARGET_ENABLE_ROOT_LOGIN is not set
BR2_TARGET_GENERIC_GETTY_PORT="ttyO0"
BR2_TARGET_GENERIC_GETTY_BAUDRATE_115200=y
BR2_TARGET_GENERIC_GETTY_TERM="linux"
BR2_ROOTFS_USERS_TABLES="$(BR2_EXTERNAL_FTCOMMUNITY_TXT_PATH)/board/fischertechnik/TXT/user.tab"
BR2_ROOTFS_OVERLAY="$(BR2_EXTERNAL_FTCOMMUNITY_TXT_PATH)/board/fischertechnik/TXT/initramfs"
BR2_ROOTFS_POST_BUILD_SCRIPT="$(BR2_EXTERNAL_FTCOMMUNITY_TXT_PATH)/board/fischertechnik/TXT/initramfs-post-build.sh"
BR2_PACKAGE_BUSYBOX_SHOW_OTHERS=y
BR2_PACKAGE_DOSFSTOOLS=y
BR2_PACKAGE_DOSFSTOOLS_FSCK_FAT=y
BR2_PACKAGE_DOSFSTOOLS_MKFS_FAT=y
BR2_PACKAGE_E2FSPROGS=y
BR2_PACKAGE_FBV=y
BR2_PACKAGE_PSPLASH=y
# BR2_PACKAGE_IFUPDOWN_SCRIPTS is not set
BR2_TARGET_ROOTFS_CPIO=y
BR2_TARGET_ROOTFS_CPIO_NONE=y
# BR2_TARGET_ROOTFS_TAR is not set
BR2_PACKAGE_HOST_KMOD=y
BR2_PACKAGE_HOST_UBOOT_TOOLS=y
```
