## package/python-lumaoled/Config.in
```kconfig
config BR2_PACKAGE_PYTHON_LUMAOLED
	bool "python-lumaoled"
	select BR2_PACKAGE_PYTHON_LUMACORE # runtime
	help
	  A small library to drive an OLED device with either
	  SSD1306, SSD1309, SSD1322, SSD1325, SSD1327, SSD1331,
	  SSD1351 or SH1106 chipset.

	  https://github.com/rm-hull/luma.oled
```

## package/python-nbconvert/Config.in
```kconfig
config BR2_PACKAGE_PYTHON_NBCONVERT
	bool "python-nbconvert"
	select BR2_PACKAGE_PYTHON_MISTUNE # runtime
	select BR2_PACKAGE_PYTHON_JINJA2 # runtime
	select BR2_PACKAGE_PYTHON_PYGMENTS # runtime
	select BR2_PACKAGE_PYTHON_TRAITLETS # runtime
	select BR2_PACKAGE_PYTHON_JUPYTER_CORE # runtime
	select BR2_PACKAGE_PYTHON_NBFORMAT # runtime
	select BR2_PACKAGE_PYTHON_ENTRYPOINTS # runtime
	select BR2_PACKAGE_PYTHON_BLEACH # runtime
	help
	  Converting Jupyter Notebooks.

	  http://jupyter.org
```

## package/python-nbformat/Config.in
```kconfig
config BR2_PACKAGE_PYTHON_NBFORMAT
	bool "python-nbformat"
	select BR2_PACKAGE_PYTHON_IPYTHON_GENUTILS # runtime
	select BR2_PACKAGE_PYTHON_TRAITLETS # runtime
	select BR2_PACKAGE_PYTHON_JSONSCHEMA # runtime
	select BR2_PACKAGE_PYTHON_JUPYTER_CORE # runtime
	help
	  The Jupyter Notebook format.

	  http://jupyter.org
```

## package/python-notebook/Config.in
```kconfig
config BR2_PACKAGE_PYTHON_NOTEBOOK
	bool "python-notebook"
	select BR2_PACKAGE_PYTHON_JINJA2 # runtime
	select BR2_PACKAGE_PYTHON_TORNADO # runtime
	select BR2_PACKAGE_PYTHON_IPYTHON_GENUTILS # runtime
	select BR2_PACKAGE_PYTHON_TRAITLETS # runtime
	select BR2_PACKAGE_PYTHON_JUPYTER_CORE # runtime
	select BR2_PACKAGE_PYTHON_JUPYTER_CLIENT # runtime
	select BR2_PACKAGE_PYTHON_NBFORMAT # runtime
	#select BR2_PACKAGE_PYTHON_NBCONVERT # runtime
	select BR2_PACKAGE_PYTHON_IPYKERNEL # runtime
	help
	  A web-based notebook environment for interactive computing.

	  http://jupyter.org
```

## package/python-pandas/Config.in
```kconfig
config BR2_PACKAGE_PYTHON_PANDAS
	bool "python-pandas"
	select BR2_PACKAGE_PYTHON_DATEUTIL
	select BR2_PACKAGE_PYTHON_PYTZ
	select BR2_PACKAGE_PYTHON_NUMPY
	select BR2_PACKAGE_PYTHON_MATPLOTLIB
	select BR2_PACKAGE_PYTHON3_BZIP2
	select BR2_PACKAGE_HOST_PYTHON_NUMPY
	select BR2_PACKAGE_HOST_PYTHON_CYTHON
	help
	  Pandas ML library.
```

## package/python-pillow/Config.in
```kconfig
config BR2_PACKAGE_PYTHON_PILLOW
	bool "python-pillow"
	help
	  Python Imaging Library (Fork)

	  https://github.com/python-pillow/Pillow
```

## package/python-pygments/Config.in
```kconfig
config BR2_PACKAGE_PYTHON_PYGMENTS
	bool "python-pygments"
	help
	  Pygments is a syntax highlighting package written in Python.

	  http://pygments.org/
```

## package/python-robolt/Config.in
```kconfig
config BR2_PACKAGE_PYTHON_ROBOLT
	bool "python-robolt"
        select BR2_PACKAGE_PYTHON_PYUSB
	help
	  Python interface for the Fischertechnik RoboLT

	  https://github.com/ftCommunity/python-robolt
```

## package/python-semantic-version/Config.in
```kconfig
config BR2_PACKAGE_PYTHON_SEMANTIC_VERSION
	bool "python-semantic-version"
	depends on BR2_PACKAGE_PYTHON || BR2_PACKAGE_PYTHON3
	help
	  Semantic version in Python

	  https://pypi.python.org/pypi/semantic_version
```

## package/python-simplegeneric/Config.in
```kconfig
config BR2_PACKAGE_PYTHON_SIMPLEGENERIC
	bool "python-simplegeneric"
	help
	  Simple generic functions (similar to Python's own len(),
	  pickle.dump(), etc.).

	  http://cheeseshop.python.org/pypi/simplegeneric
```

## package/python-sip-qt5/Config.in
```kconfig
config BR2_PACKAGE_PYTHON_SIP_QT5
	bool "python-sip-qt5"
	depends on BR2_PACKAGE_PYTHON_PYQT5
	depends on BR2_PACKAGE_PYTHON_SIP
	help
	  SIP is a tool that makes it very easy to create Python bindings
          for C and C++ libraries. It was originally developed to create PyQt,
	  the Python bindings for the Qt toolkit, but can be used to
	  create bindings for any C or C++ library.
```

## package/python-traitlets/Config.in
```kconfig
config BR2_PACKAGE_PYTHON_TRAITLETS
	bool "python-traitlets"
	select BR2_PACKAGE_PYTHON_IPYTHON_GENUTILS # runtime
	select BR2_PACKAGE_PYTHON_SIX # runtime
	select BR2_PACKAGE_PYTHON_DECORATOR # runtime
	help
	  Traitlets Python config system.

	  http://ipython.org
```

## package/python-websockets/Config.in
```kconfig
config BR2_PACKAGE_PYTHON_WEBSOCKETS
	bool "python-websockets"
	help
	  Websocket support for Python

	  https://pypi.python.org/pypi/websockets
```

## package/python-wedo/Config.in
```kconfig
config BR2_PACKAGE_PYTHON_WEDO
	bool "python-wedo"
        select BR2_PACKAGE_PYTHON_PYUSB
	help
	  Python interface for the Lego WeDo hub

	  https://github.com/itdaniher/WeDoMore
```

## package/python-zbarlight/Config.in
```kconfig
config BR2_PACKAGE_PYTHON_ZBARLIGHT
	bool "python-zbarlight"
	depends on BR2_PACKAGE_ZBAR
	depends on BR2_PACKAGE_PYTHON_PILLOW
	help
	  Python3 compatible bindings for the zbar library

	  https://github.com/Polyconseil/zbarlight
```

## package/touchui-system-apps/Config.in
```kconfig
menu "TouchUI system apps"
  config BR2_PACKAGE_TOUCHUI_SYSTEM_APPS
    #depends on BR2_TOUCHUI
    bool "TouchUI system apps"

  menu "Preset lists"
    depends on BR2_PACKAGE_TOUCHUI_SYSTEM_APPS
    config BR2_PACKAGE_TOUCHUI_SYSTEM_APPS_PRESET_TXT
      bool "fischertechnik TXT Controller"
      select BR2_PACKAGE_TOUCHUI_SYSTEM_APPS_ABOUT
      select BR2_PACKAGE_TOUCHUI_SYSTEM_APPS_BLUETOOTH
      select BR2_PACKAGE_TOUCHUI_SYSTEM_APPS_DISPLAY
      select BR2_PACKAGE_TOUCHUI_SYSTEM_APPS_FTGUI
      select BR2_PACKAGE_TOUCHUI_SYSTEM_APPS_LANGUAGE
      select BR2_PACKAGE_TOUCHUI_SYSTEM_APPS_NETWORK
      select BR2_PACKAGE_TOUCHUI_SYSTEM_APPS_STORE
      select BR2_PACKAGE_TOUCHUI_SYSTEM_APPS_WLAN
  endmenu

  menu "Manual Choose List"
    depends on BR2_PACKAGE_TOUCHUI_SYSTEM_APPS

    config BR2_PACKAGE_TOUCHUI_SYSTEM_APPS_ABOUT
      bool "About"

    config BR2_PACKAGE_TOUCHUI_SYSTEM_APPS_BLUETOOTH
      bool "Bluetooth"

    config BR2_PACKAGE_TOUCHUI_SYSTEM_APPS_DISPLAY
      bool "Display"

    config BR2_PACKAGE_TOUCHUI_SYSTEM_APPS_FTGUI
      bool "ft-GUI"

    config BR2_PACKAGE_TOUCHUI_SYSTEM_APPS_LANGUAGE
      bool "Language"

    config BR2_PACKAGE_TOUCHUI_SYSTEM_APPS_NETWORK
      bool "Network"

    config BR2_PACKAGE_TOUCHUI_SYSTEM_APPS_STORE
      bool "Store"

    config BR2_PACKAGE_TOUCHUI_SYSTEM_APPS_WLAN
      bool "WLAN"
  endmenu
endmenu
```

## package/touchui/Config.in
```kconfig
comment "Enable Qt to enable TouchUI"
  depends on !BR2_PACKAGE_QT
comment "Enable Qt/JPEG Support to enable TouchUI"
  depends on BR2_PACKAGE_QT_NOJPEG
comment "Enable Qt/PNG Support to enable TouchUI"
  depends on BR2_PACKAGE_QT_NOPNG

config BR2_PACKAGE_TOUCHUI
  bool "TouchUI"
  depends on BR2_PACKAGE_QT
  depends on BR2_PACKAGE_QT_SYSTEMJPEG
  depends on BR2_PACKAGE_QT_SYSTEMPNG
  select BR2_PACKAGE_QT_LICENSE_APPROVED
  select BR2_PACKAGE_QT_ARCH_SUPPORTS_WEBKIT
  select BR2_PACKAGE_QT_ARCH_SUPPORTS_SCRIPT
  select BR2_PACKAGE_QT_OPENSSL
  select BR2_PACKAGE_QT_KEYBOARD_TTY
  select BR2_PACKAGE_QT_MOUSE_TSLIB
  select BR2_PACKAGE_QT_MOUSE_NO_QWS_CURSOR
  select BR2_PACKAGE_QT_GFX_TRANSFORMED
  select BR2_PACKAGE_PYTHON_PYQT
  select BR2_PACKAGE_PYTHON_PYQT_ARCH_USES_QREAL_FLOAT
  help
    TouchUI is a simple desktop environment
    It can handle apps and plugins

  config BR2_PACKAGE_TOUCHUI_INITD_ENABLE
    depends on BR2_PACKAGE_TOUCHUI
    bool "add to init.d"
    default y

  if BR2_PACKAGE_TOUCHUI_INITD_ENABLE
    config BR2_PACKAGE_TOUCHUI_INITD_NAME
      string "init.d filename"
      default S90touchui
  endif

  config BR2_PACKAGE_TOUCHUI_USER
    depends on BR2_PACKAGE_TOUCHUI
    string "username for touchui and user apps folder"

  config BR2_PACKAGE_TOUCHUI_VNC_SUPPORT
    depends on BR2_PACKAGE_TOUCHUI
    bool "VNC SERVER (disabled by default)"
    select BR2_PACKAGE_QT_GFX_VNC
    select BR2_PACKAGE_QT_GFX_MULTISCREEN

  comment "Enable VNC server only if you have a firewall which prevents it from beeing use without authentication"
  config BR2_PACKAGE_TOUCHUI_VNC_ENABLE
    depends on BR2_PACKAGE_TOUCHUI_VNC_SUPPORT
    bool "VNC server autostart"
```
